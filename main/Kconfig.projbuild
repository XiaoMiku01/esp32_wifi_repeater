## main/Kconfig.projbuild
```kconfig
menu "Wi-Fi Repeater"

    config REPEATER_STA_SSID
        string "上游路由器 SSID"
        default "upstream_ssid"

    config REPEATER_STA_PASSWORD
        string "上游路由器密码（开放网络留空）"
        default "upstream_password"

    config REPEATER_AP_SSID
        string "本机 AP SSID"
        default "ESP32-Repeater"

    config REPEATER_AP_PASSWORD
        string "本机 AP 密码（>=8 位，留空为开放网络）"
        default "12345678"

    config REPEATER_AP_MAX_CONN
        int "AP 最大客户端数"
        range 1 15
        default 8

    config REPEATER_LED_GPIO
        int "板载 WS2812 灯数据引脚（开机默认，可用 /api/led 的 gpio= 临时切换）"
        range 0 48
        default 48

    config REPEATER_MONITOR_DEFAULT_ON
        bool "开机默认开启流量记录与拦截"
        default y if SPIRAM
        default n
        help
            关闭时开机不分配记录表（客户端、连接、DNS 记录），转发钩子直接放行，
            省内存和 CPU；可在记录页随时开启（首次开启时分配）。
            DNS 黑名单与记录页的域名黑名单（DNS 层面）不受影响。
            没有 PSRAM 的芯片（如 ESP32-C3/C6）默认关闭，记录表也按较小容量分配。

endmenu
```
